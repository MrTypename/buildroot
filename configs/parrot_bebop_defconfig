## configs/parrot_bebop_defconfig
```kconfig
# Using buildoot version '2017.05'.
#
# This configuration is derived from:
# 'configs/qemu_arm_vexpress_defconfig'
#
# Adapted for 'Parrot Mambo' target environment.
#
# ---------------------------------------------------------------------
# Usage:
# Configuration can be performed as follows:
#
# Configure 'buildroot':
# - 'make menuconfig' -> result stored in '.config'
# 
# Create 'defconfig':
# - 'make savedefconfig' -> input: '.config' -> result stored in 'defconfig'
# - Rename 'defconfig' (e.g.: my_defconfig) and copy to ./configs/'
# 
# Use 'defconfig':
# - 'make xxx_defconfig' (e.g.: make my_defconfig) -> result stored in '.config'
# ---------------------------------------------------------------------
# CPU configuration:
BR2_arm=y
BR2_cortex_a9=y
BR2_ARM_ENABLE_NEON=y
BR2_ARM_ENABLE_VFP=y

# Required during docker container build:
BR2_WGET="wget --no-check-certificate --passive-ftp -nd -t 3"

# Target is running kernel version '3.4.11':
BR2_KERNEL_HEADERS_VERSION=y
BR2_DEFAULT_KERNEL_VERSION="3.4.11"
BR2_PACKAGE_HOST_LINUX_HEADERS_CUSTOM_3_4=y

# Toolchain with 'glibc' version '2.23' is build:
BR2_TOOLCHAIN_BUILDROOT_GLIBC=y

# Toolchain with 'gcc' version '4.8.5' is build:
BR2_GCC_VERSION_4_8_X=y

# Additional host tools:
BR2_PACKAGE_HOST_GDB=y
BR2_PACKAGE_HOST_GDB_TUI=y
BR2_PACKAGE_HOST_GDB_SIM=y
```

## configs/parrot_mambo_defconfig
```kconfig
# Using buildoot version '2017.05'.
#
# This configuration is derived from:
# 'configs/qemu_arm_versatile_defconfig'
#
# Adapted for 'Parrot Mambo' target environment.
#
# ---------------------------------------------------------------------
# Usage:
# Configuration can be performed as follows:
#
# Configure 'buildroot':
# - 'make menuconfig' -> result stored in '.config'
# 
# Create 'defconfig':
# - 'make savedefconfig' -> input: '.config' -> result stored in 'defconfig'
# - Rename 'defconfig' (e.g.: my_defconfig) and copy to ./configs/'
# 
# Use 'defconfig':
# - 'make xxx_defconfig' (e.g.: make my_defconfig) -> result stored in '.config'
# ---------------------------------------------------------------------
# CPU configuration:
BR2_arm=y

# Required during docker container build:
BR2_WGET="wget --no-check-certificate --passive-ftp -nd -t 3"

# Target is running kernel version '2.6.36':
BR2_KERNEL_HEADERS_VERSION=y
BR2_DEFAULT_KERNEL_VERSION="2.6.36"
BR2_PACKAGE_HOST_LINUX_HEADERS_CUSTOM_REALLY_OLD=y

# Toolchain with 'glibc' version '2.23' is build:
BR2_TOOLCHAIN_BUILDROOT_GLIBC=y

# Toolchain with 'gcc' version '4.8.5' is build:
BR2_GCC_VERSION_4_8_X=y

# Additional host tools:
BR2_PACKAGE_HOST_GDB=y
BR2_PACKAGE_HOST_GDB_TUI=y
BR2_PACKAGE_HOST_GDB_SIM=y

# Additional target packages:
BR2_PACKAGE_GDB=y
BR2_GDB_VERSION_7_12=y
BR2_PACKAGE_NANO=y
BR2_PACKAGE_OPENSSH=y
BR2_PACKAGE_RSYNC=y
BR2_PACKAGE_STRACE=y
BR2_PACKAGE_VALGRIND=y

# ---------------------------------------------------------------------
# Subsequent configuration is used to generate a QEMU environment:

# Additional target / rootfs configurations:
BR2_SYSTEM_DHCP="eth0"
BR2_TARGET_ROOTFS_EXT2=y
BR2_TARGET_GENERIC_ROOT_PASSWD="root"
BR2_TARGET_GENERIC_GETTY_PORT="ttyAMA0"
BR2_ROOTFS_OVERLAY="rootfs_overlay"
BR2_ROOTFS_POST_BUILD_SCRIPT="scripts/fix_rootfs_permission.sh"

# Kernel configuration:
BR2_LINUX_KERNEL=y
BR2_LINUX_KERNEL_CUSTOM_VERSION=y
BR2_LINUX_KERNEL_CUSTOM_VERSION_VALUE="2.6.36"
BR2_LINUX_KERNEL_USE_CUSTOM_CONFIG=y
BR2_LINUX_KERNEL_CUSTOM_CONFIG_FILE="board/qemu/arm-versatile/linux-2.6.36.config"

# QEMU configuration:
BR2_PACKAGE_HOST_QEMU=y
BR2_PACKAGE_HOST_QEMU_SYSTEM_MODE=y
BR2_PACKAGE_HOST_QEMU_LINUX_USER_MODE=y
BR2_PACKAGE_HOST_QEMU_VDE2=y
```
